## drivers/input/Kconfig
```kconfig
# Copyright (c) 2022 The ZMK Contributors
# SPDX-License-Identifier: MIT

menuconfig INPUT_IQS5XX
    bool "Azoteq IQS5XX trackpads"
    default y
    depends on GPIO
    depends on I2C
    depends on INPUT
    depends on DT_HAS_AZOTEQ_IQS5XX_ENABLED
    help
      Enable driver for Azoteq IQS5XX trackpads
```

## dts/bindings/input/azoteq,iqs5xx.yaml
```yaml
description: |
  Sensor driver for the Azoteq IQS5XX trackpad, using the I2C interface

compatible: "azoteq,iqs5xx"

include: ["i2c-device.yaml"]

properties:
  dr-gpios:
    type: phandle-array
    description: Data ready pin for the trackpad
```
